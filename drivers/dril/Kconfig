## drivers/dril/Kconfig
```kconfig
# SPDX-License-Identifier: GPL-2.0
#
# DRIL course modules
#

menu "DRIL modules"

config DRIL_HELLO
       tristate "Hello World!"

config DRIL_GREET
       tristate "Greet"

endmenu
```
